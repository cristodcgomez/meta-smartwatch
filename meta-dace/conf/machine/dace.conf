## meta-ticwatch-pro-5/conf/layer.conf
```bitbake
BBPATH .= ":${LAYERDIR}"
BBFILES += "${LAYERDIR}/recipes*/*/*.bb ${LAYERDIR}/recipes*/*/*.bbappend"
BBFILE_COLLECTIONS += "ticwatch-pro-5-hybris-layer"
BBFILE_PATTERN_ticwatch-pro-5-hybris-layer := "^${LAYERDIR}/"
BBFILE_PRIORITY_ticwatch-pro-5-hybris-layer = "8"
LAYERSERIES_COMPAT_ticwatch-pro-5-hybris-layer = "walnascar"
```
